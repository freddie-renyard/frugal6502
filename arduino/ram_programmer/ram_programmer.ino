// Shift register pins
#define SHIFT_REG_OE 2
#define REG_DATA 3
#define REG_LATCH 4
#define REG_CLOCK 5

#define CLK_SPEED A3

// RAM pins
#define CH_EN A0 // Chip enable. Write enable is the MSB of the shift register.
#define RAM_WRITE A5 // Status pin to disable the 6502's buses when the arduino is writing
#define RST_VEC 0x0200 // 6502 reset vector

// Clock Pin
#define CLK_PIN 12

// Define the data bus output pins
int data_pins[8] = {A1, A4, A2, 6, 7, 8, 9, 10};

// Define the program. To do: Move into PROGMEM
const uint8_t program[] = {0x20, 0x1f, 0x2, 0xa2, 0x0, 0x20, 0x40, 0x2, 0x20, 0x49, 0x2, 0x20, 0xe9,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 0x71, 0x0};

// Clock period in milliseconds
int period = 100;

// Set this byte to 1 to put the device in debugging mode.
byte debug = 0;

// Serial Parameters
#define BAUD 9600

// Clock parameters
// Set limits to check any erroneous readings from analogRead.
const int lower = (0 << 3);
const int upper = (1024 << 3);

void setup() {
  
    setup_general();
    setup_write();

    if (debug)  {
        write_nop();
        Serial.begin(BAUD);
    }
    
    write_prog();
    end_write();
    setup_timer();
}

void loop() {
    // put your main code here, to run repeatedly:
    if (debug) 
        print_data_bus();
}

void update_period () {
  
    int value =  (analogRead(CLK_SPEED) << 3);

    if (value > lower && value < upper) {
        OCR1A = value;
    }
}
void print_data_bus () {
    // Read and display the current state of the data bus 
    // on the serial monitor. Useful for debugging.
    
    byte received = 0x00;
    for (int i = 0; i < 8; i++) {
        bitWrite(received, i, digitalRead(data_pins[i]));
    }
    
    Serial.println(received, HEX);

}

void setup_timer () {
    // Set up timer 1 for clock generation.

    // Clear the bits in both timer configuration registers.
    TCCR1A = 0;        
    TCCR1B = 0;  
    TCNT1 = 0;

    TCCR1B |= (1 << WGM12);   // Set timer to CTC mode.

    // Set timer prescale to 1024
    TCCR1B |= (1 << CS10);  
    TCCR1B |= (1 << CS12);     

    // Enable interrupt on comparison to OCR1A.
    TIMSK1 = (1 << OCIE1A);

    // Set an initial value of the comparison register.
    OCR1A = 2;
}

ISR(TIMER1_COMPA_vect) { 
    // The interrupt which is called when timer2 
    // is equal to the compare register. It toggles
    // the clock output pin and sets a new period
    // by reading the clock speed potentiometer.
    
    digitalWrite(CLK_PIN, digitalRead(CLK_PIN) ^ 1);
    update_period();
}

void setup_general() {
    pinMode(CLK_SPEED, INPUT);
    
    // Setup the shift register pins
    pinMode(REG_DATA, OUTPUT);
    pinMode(REG_LATCH, OUTPUT);
    
    pinMode(REG_CLOCK, OUTPUT);
    digitalWrite(CLK_PIN, LOW);
}

void setup_write() {

    // Disable the 6502 output buses first.
    pinMode(RAM_WRITE, OUTPUT);
    digitalWrite(RAM_WRITE, LOW);
    
    // Set up RAM control pins
   
    pinMode(CH_EN, OUTPUT);
    digitalWrite(CH_EN, HIGH);
  
    pinMode(CLK_PIN, OUTPUT);
    digitalWrite(CLK_PIN, LOW);

    pinMode(SHIFT_REG_OE, OUTPUT);
    digitalWrite(SHIFT_REG_OE, LOW);

    for (int i = 0; i < 8; i++) {
        pinMode(data_pins[i], OUTPUT);
    }
  
}

void end_write () {

  // Set address bus to high impendance
  digitalWrite(SHIFT_REG_OE, HIGH);

  // Set data bus to high impedance
  for (int i = 0; i < 8; i++) {
      pinMode(data_pins[i], INPUT);
  }

  pinMode(CH_EN, INPUT);
  digitalWrite(RAM_WRITE, HIGH);
  //pinMode(RAM_WRITE, INPUT_PULLUP);
  
}

void write_prog () {

  for (int i = 0; i < sizeof(program); i++) {
      ram_write(i + RST_VEC, program[i]);
  }

  // Load the RAM with the start address.
  ram_write(0x7ffc, 0x00);
  ram_write(0x7ffd, 0x02);
}

void write_nop () {
    // Fill the RAM with NOP instructions (0xEA opcode)
    // Useful for debugging.

    // Write to 255 contiguous addresses in RAM
    for (unsigned int i = 0; i < 0x8000; i++) {
        ram_write(i, 0xea);
    }
    
}

void ram_write(unsigned int addr, unsigned int data) {
    // Write a data word to an address in the external 32kb RAM.

    // Begin shift register write
    digitalWrite(REG_LATCH, LOW);

    // Shift the data into the 16bit shift register
    shiftOut(REG_DATA, REG_CLOCK, LSBFIRST, addr);
    shiftOut(REG_DATA, REG_CLOCK, LSBFIRST, (addr >> 8));

    // Latch the data.
    digitalWrite(REG_LATCH, HIGH);

    // Prepare the RAM for a write
    digitalWrite(CH_EN, LOW);
    digitalWrite(CLK_PIN, HIGH);

    for (int i = 0; i < 8; i++) {
        digitalWrite(data_pins[i], bitRead(data, i));
    }

    digitalWrite(CH_EN, HIGH);
    digitalWrite(CLK_PIN, LOW);
}
